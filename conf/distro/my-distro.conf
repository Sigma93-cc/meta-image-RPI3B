## conf/distro/my-distro.conf
```bitbake
require conf/distro/poky.conf


DISTRO = "SigmaStudio Linux"
DISTRO_NAME = "Embedded Linux distro provided by SigmaStudio as SigovAS "
DISTRO_VERSION := "${@bb.process.run('git describe --tags --always --dirty',cwd=d.getVar('LAYERDIR_meta-my'))[0].strip() or '0.0.0'}"

DISTRO_FEATURES:append = " usrmerge systemd"
DISTRO_FEATURES:remove = "x11 opengl wayland"
VIRTUAL-RUNTIME_init_manager = "systemd"
VIRTUAL-RUNTIME_initscripts = ""
VIRTUAL-RUNTIME_login_manager = "shadow-base"


DISTRO_FEATURES_BACKFILL_CONSIDERED += "sysvinit"
TOOLCHAIN_HOST_TASK:append = " nativesdk-packagegroup-qt5-toolchain-host"
TOOLCHAIN_TARGET_TASK:append= " qtbase-dev qtbase-mkspecs"
PACKAGE_CLASSES = "package_deb"
```

## conf/distro/sigmastudio.conf
```bitbake
require conf/distro/poky.conf


DISTRO = "sigmastudio"
DISTRO_NAME = "SigmaOS"
DISTRO_VERSION := "${@bb.process.run('git describe --tags --always --dirty',cwd=d.getVar('LAYERDIR_meta-my'))[0].strip() or '0.0.0'}"

INIT_MANAGER = "systemd"
DISTRO_FEATURES:remove = "x11 opengl wayland"
VIRTUAL-RUNTIME_initscripts = ""

VIRTUAL-RUNTIME_base-utils = "packagegroup-core-base-utils"
VIRTUAL-RUNTIME_base-utils-hwclock = "util-linux-hwclock"
VIRTUAL-RUNTIME_base-utils-syslog = ""
PREFERRED_PROVIDER_virtual/base-utils-shell = "bash"
PACKAGE_EXCLUDE += "busybox busybox-syslog"

DISTRO_FEATURES_BACKFILL_CONSIDERED += "sysvinit"
PACKAGE_CLASSES = "package_deb"
```

## conf/machine/include/panel-waveshare35b.inc
```bitbake
PANEL_FB_DRIVER     = "fb_ili9486"
PANEL_TOUCH_DRIVER  = "ads7846"
PANEL_DTOVERLAY     = "waveshare35b-v2"
PANEL_TOUCH_ROTATE  = "90"
PANEL_FB_SYMLINK    = "mainscreen"
PANEL_KCONFIG_FRAG  = "waveshare35b.cfg"

MACHINE_ESSENTIAL_EXTRA_RDEPENDS += " \
    kernel-module-${PANEL_TOUCH_DRIVER} \
"
```

## conf/machine/sigmastudio-rpi3.conf
```bitbake
MACHINEOVERRIDES =. "raspberrypi3-64:"

require conf/machine/raspberrypi3-64.conf
require conf/machine/include/panel-waveshare35b.inc

ENABLE_UART = "1"
ENABLE_SPI_BUS = "1"
RPI_EXTRA_CONFIG = "dtoverlay=${PANEL_DTOVERLAY}\ndtoverlay=disable-bt"
DISPLAY_ROTATE = "0"
DISABLE_VC4GRAPHICS = "1"
DISABLE_RPI_BOOT_LOGO = "1"
RPI_USE_U_BOOT = "1"
SERIAL_CONSOLES = "115200;ttyAMA0"

IMAGE_BOOT_FILES:append = " ${PANEL_DTOVERLAY}.dtbo;overlays/${PANEL_DTOVERLAY}.dtbo"
```
